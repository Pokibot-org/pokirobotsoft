## zephyr/Kconfig
```kconfig
source "Kconfig.zephyr"

menu "POKIBOT extra settings"


config ONE_THREAD_TESTING
    bool "If activated, turn off all threads"
    default n


config ODOMETRY_THREAD_ENABLED
    bool "Activate the speed and position odometry thread"
    default y
    default n if ONE_THREAD_TESTING
config ODOMETRY_THREAD_STACK
    int "Stack size"
    default 1024
config ODOMETRY_THREAD_PRIORITY
    int "Thread priority"
    default 3


config SPEED_CONTROL_THREAD_ENABLED
    bool "Activate the speed closed control loop thread"
    default y
    default n if ONE_THREAD_TESTING

config SPEED_CONTROL_THREAD_STACK
    int "Stack size"
    default 2048

config SPEED_CONTROL_THREAD_PRIORITY
    int "Thread priority"
    default 5

config POS_CONTROL_THREAD_ENABLED
    bool "Activate the speed closed control loop thread"
    default y
    default n if ONE_THREAD_TESTING

config POS_CONTROL_THREAD_STACK
    int "Stack size"
    default 2048

config POS_CONTROL_THREAD_PRIORITY
    int "Thread priority"
    default 4



config OBSTACLE_MANAGER_THREAD_ENABLED
    bool "Activate the obstacle manager thread"
    default y
    default n if ONE_THREAD_TESTING
config OBSTACLE_MANAGER_THREAD_STACK
    int "Stack size"
    default 1024
config OBSTACLE_MANAGER_THREAD_PRIORITY
    int "Thread priority"
    default 10


config THREAD_KILLER_THREAD_ENABLED
    bool "Activate the thread killer"
    default y
    default n if ONE_THREAD_TESTING

config THREAD_KILLER_THREAD_STACK
    int "Stack size"
    default 512

config THREAD_KILLER_THREAD_PRIORITY
    int "Thread priority"
    default 1


config MATCH_THREAD_ENABLED
    bool "Activate the thread killer"
    default y
    default n if ONE_THREAD_TESTING

config MATCH_THREAD_STACK
    int "Stack size"
    default 1024

config MATCH_THREAD_PRIORITY
    int "Thread priority"
    default 7

config PATH_MANAGER_THREAD_STACK
    int "Stack size"
    default 4096
config PATH_MANAGER_THREAD_PRIORITY
    int "Thread priority"
    default 14

endmenu
```

## zephyr/boards/arm/nucleo_f446re_pokibot/Kconfig.board
```kconfig
# STM32F446RE POKIBOT Nucleo board configuration

# Copyright (c) 2018 Philémon Jaermann
# SPDX-License-Identifier: Apache-2.0

config BOARD_NUCLEO_F446RE_POKIBOT
	bool "Nucleo F446RE POKIBOT Development Board"
	depends on SOC_STM32F446XX
```

## zephyr/boards/arm/nucleo_f446re_pokibot/Kconfig.defconfig
```kconfig
# STM32F446RE POKIBOT Nucleo board configuration

# Copyright (c) 2018 Philémon Jaermann
# SPDX-License-Identifier: Apache-2.0

if BOARD_NUCLEO_F446RE_POKIBOT

config BOARD
	default "nucleo_f446re_pokibot"

config SPI_STM32_INTERRUPT
	default y
	depends on SPI

endif # BOARD_NUCLEO_F446RE_POKIBOT
```

## zephyr/boards/arm/weact_stm32h743vi/Kconfig.board
```kconfig
# STM32H743ZI Nucleo board configuration

config BOARD_WEACT_STM32H743VI
	bool "WeAct H743VI Development Board"
	depends on SOC_STM32H743XX
```

## zephyr/boards/arm/weact_stm32h743vi/Kconfig.defconfig
```kconfig
if BOARD_WEACT_STM32H743VI

config BOARD
	default "weact_stm32h743vi"

endif # BOARD_WEACT_STM32H743VI
```

## zephyr/boards/arm/weact_stm32h743vi/weact_stm32h743vi_defconfig
```kconfig
# SPDX-License-Identifier: Apache-2.0

CONFIG_SOC_SERIES_STM32H7X=y
CONFIG_SOC_STM32H743XX=y
# 480MHz system clock
CONFIG_SYS_CLOCK_HW_CYCLES_PER_SEC=480000000

# Enable MPU
CONFIG_ARM_MPU=y

# Enable HW stack protection
CONFIG_HW_STACK_PROTECTION=y

CONFIG_PINMUX=y

# Enable UART
CONFIG_SERIAL=y

# Console
CONFIG_CONSOLE=y
CONFIG_UART_CONSOLE=y

# Enable GPIO
CONFIG_GPIO=y

# Clock Configuration
CONFIG_CLOCK_CONTROL=y

# Crystal at 25 MHz
CONFIG_CLOCK_STM32_HSE_CLOCK=25000000
CONFIG_CLOCK_STM32_SYSCLK_SRC_PLL=y
# Use HSE as PLL input
CONFIG_CLOCK_STM32_PLL_SRC_HSE=y

# Produce 480MHz clock at PLL output
CONFIG_CLOCK_STM32_PLL_M_DIVISOR=5
CONFIG_CLOCK_STM32_PLL_N_MULTIPLIER=192
CONFIG_CLOCK_STM32_PLL_P_DIVISOR=2
CONFIG_CLOCK_STM32_PLL_Q_DIVISOR=2
CONFIG_CLOCK_STM32_PLL_R_DIVISOR=2

CONFIG_CLOCK_STM32_HPRE=2
CONFIG_CLOCK_STM32_D2PPRE1=2
CONFIG_CLOCK_STM32_D2PPRE2=2
CONFIG_CLOCK_STM32_D1PPRE=2
CONFIG_CLOCK_STM32_D3PPRE=2
```
